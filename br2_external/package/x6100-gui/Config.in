## br2_external/package/x6100-gui/Config.in
```kconfig
config BR2_PACKAGE_X6100_GUI
	bool "x6100_gui"
	select BR2_PACKAGE_LIBPNG
	select BR2_PACKAGE_AETHER_X6100_CONTROL
	select BR2_PACKAGE_RHVOICE
	select BR2_PACKAGE_FT8LIB
	select BR2_PACKAGE_LIBCURL
	select BR2_PACKAGE_JANSSON
	help
	  X6100 GUI application
```
